

/* 系统头文件 */
#include "stm32f10x.h"
#include "systemconfig.h"
#include "stdio.h"

/* lkdGui驱动相关文件 */
#include "UC1698Driver.h"
#include "lkdGui.h"

extern uint8_t lkdGuiImage[];
extern uint8_t lkdGuiImage2[];
int main(void)
{
	SystemconfigInit();
	
	LcdInit();/* lcd初始化 */
	defaultFontInit();/* 字库初始化 */
	GuiUpdateDisplayAll();/* 更新屏幕-清屏 */
	
	lkdBitmap tImage;
	tImage.beginx = 0;/* 图像开始显示偏移 */
	tImage.beginy = 0;
	tImage.wide = 144;/* 图像本身的大小 */
	tImage.high = 40;
	tImage.bitmap = lkdGuiImage2;/* 图像 */
	GuiAreaBitMap(&tImage,10, 5, 154, 45, 0);
	GuiUpdateDisplayAll();/* 更新 */
	while(1)
	{
		for(uint8_t i = 0; i < 144; i += 10){
			tImage.beginx = i;
			tImage.beginy = 0;
			GuiAreaBitMap(&tImage,10, 95, 159, 159, 0);
			GuiUpdateDisplayAll();
			Delay_ms(100);
		}
		for(int16_t i = 140; i >= 0; i -= 10){
			tImage.beginx = i;
			tImage.beginy = 0;
			GuiAreaBitMap(&tImage,10, 95, 159, 159, 0);
			GuiUpdateDisplayAll();
			Delay_ms(100);
		}
		for(uint8_t i = 0; i <= 39; i += 10){
			tImage.beginx = 0;
			tImage.beginy = i;
			GuiFillRect(10,45,159,90,backcolor);
			GuiAreaBitMap(&tImage,10, 45, 159, 90, 0);
			GuiUpdateDisplayAll();
			Delay_ms(100);
		}
		for(int8_t i = 30; i >= 0; i -= 10){
			tImage.beginx = 0;
			tImage.beginy = i;
			GuiAreaBitMap(&tImage,10, 45, 159, 90, 0);
			GuiUpdateDisplayAll();
			Delay_ms(100);
		}
	}
}

uint8_t lkdGuiImage2[] = {
/*--  lkdGui = 144 x 40  --*/
0x00,0x00,0x00,0x00,0x00,0x00,0x00,0x00,0x00,0x00,0x00,0x00,0x00,0x00,0x00,0x00,
0x00,0x00,0x00,0x00,0x00,0x00,0x00,0x00,0x00,0x00,0x00,0x00,0x00,0x00,0x00,0x00,
0x00,0x00,0x00,0x00,0x00,0x00,0x00,0x00,0x00,0x00,0x00,0x00,0x00,0x00,0x00,0x00,
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0x00,0x00,0x00,0x00,0x00,0x00,0x00,0x00,0x00,0x00,0x00,0x00,0x00,0x00,0x00,0x00
};

/* END */
